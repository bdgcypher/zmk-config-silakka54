## config/west.yml
```yaml
manifest:
    defaults:
        revision: v0.3
    remotes:
        - name: zmkfirmware
          url-base: https://github.com/zmkfirmware
        #   Enable custom nice!view display
        - name: mctechnology17
          url-base: https://github.com/mctechnology17
    projects:
        - name: zmk
          remote: zmkfirmware
          import: app/west.yml
        - name: nice-view-gem #modded nice!view display
          remote: m165437 #modded nice!view display
          revision: main #modded nice!view display
    self:
        path: config
```
